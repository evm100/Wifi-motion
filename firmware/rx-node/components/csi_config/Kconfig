## firmware/rx-node/components/csi_config/Kconfig
```kconfig
menu "CSI Node Configuration"

    config CSI_NODE_ID
        int "Node ID (unique per RX device)"
        range 1 255
        default 1
        help
            Unique identifier for this CSI receiver node.
            TX node = 0, RX nodes = 1, 2, 3.

    config CSI_TARGET_IP
        string "Aggregator IP address"
        default "172.20.10.2"
        help
            IP address of the Raspberry Pi aggregator on the hotspot network.
            iPhone hotspots typically assign IPs in the 172.20.10.x range.
            Check the Pi's IP after it connects and set this accordingly.

    config CSI_TARGET_PORT
        int "Aggregator UDP port"
        range 1024 65535
        default 5005
        help
            UDP port the aggregator listens on.

    config CSI_TX_MAC
        string "TX node MAC address (AA:BB:CC:DD:EE:FF)"
        default "FF:FF:FF:FF:FF:FF"
        help
            MAC address of the TX node to filter CSI frames.
            Set to FF:FF:FF:FF:FF:FF to accept all frames.

    config CSI_WIFI_SSID
        string "WiFi hotspot SSID"
        default "iPhone"
        help
            SSID of the WiFi hotspot (e.g. iPhone personal hotspot).

    config CSI_WIFI_PASSWORD
        string "WiFi hotspot password"
        default "changeme123"
        help
            WPA2 password for the WiFi hotspot.

    config CSI_WIFI_CHANNEL
        int "WiFi channel (0 = auto-scan)"
        range 0 13
        default 0
        help
            WiFi channel. Set to 0 for auto-scan (recommended when using
            a phone hotspot since the channel is chosen by the phone).

endmenu
```

## firmware/rx-node/components/csi_stream/Kconfig
```kconfig
menu "CSI Stream Configuration"

    config CSI_RING_BUF_SIZE_KB
        int "Ring buffer size (KB, allocated in PSRAM)"
        range 8 128
        default 32
        help
            Size of the PSRAM ring buffer in kilobytes for CSI packet queuing.
            32 KB holds ~115 packets at 276 bytes each.

    config CSI_STATS_INTERVAL_MS
        int "Statistics log interval (ms)"
        range 1000 60000
        default 5000
        help
            Interval in milliseconds between CSI statistics log messages
            (packet counts, drop rate, heap usage).

    config CSI_UDP_SNDBUF_SIZE
        int "UDP socket send buffer size (bytes)"
        range 4096 65536
        default 16384
        help
            Size of the UDP socket send buffer in bytes.

    config CSI_SENDER_TASK_STACK
        int "UDP sender task stack size (bytes)"
        range 2048 8192
        default 4096
        help
            Stack size for the UDP sender task on Core 1.

    config CSI_LLTF_EN
        bool "Enable LLTF (Legacy Long Training Field) CSI capture"
        default y
        help
            Capture CSI from the Legacy Long Training Field.
            Provides 52 valid subcarriers.

    config CSI_HTLTF_EN
        bool "Enable HT-LTF (High Throughput Long Training Field) CSI capture"
        default y
        help
            Capture CSI from the HT Long Training Field.
            Provides 56 additional valid subcarriers.

    config CSI_STBC_HTLTF2_EN
        bool "Enable STBC HT-LTF2 CSI capture"
        default n
        help
            Capture CSI from the second HT-LTF in STBC frames.
            Usually not needed for ESP-NOW broadcast sensing.

endmenu
```

## firmware/rx-node/components/health_check/Kconfig
```kconfig
menu "Health Check Configuration"

    config CSI_HEALTH_INTERVAL_MS
        int "Health check log interval (ms)"
        range 1000 60000
        default 10000
        help
            Interval in milliseconds between health status log messages.
            Also controls watchdog feed rate.

    config CSI_HEALTH_TASK_STACK
        int "Health check task stack size (bytes)"
        range 2048 8192
        default 4096
        help
            Stack size for the health check task.

endmenu
```

## firmware/rx-node/components/time_sync/Kconfig
```kconfig
menu "Time Sync Configuration"

    config CSI_SNTP_SERVER
        string "SNTP server address"
        default "pool.ntp.org"
        help
            SNTP server hostname or IP. Uses a public NTP server since
            all nodes have internet access via the phone hotspot.

    config CSI_SNTP_SYNC_TIMEOUT
        int "SNTP sync timeout retries"
        range 1 30
        default 7
        help
            Number of 2-second retries waiting for initial SNTP sync.

endmenu
```

## firmware/rx-node/components/wifi_manager/Kconfig
```kconfig
menu "WiFi Manager Configuration"

    config CSI_WIFI_MAX_RETRY
        int "Maximum WiFi reconnect attempts"
        range 0 255
        default 10
        help
            Number of reconnect attempts before giving up. 0 = infinite retry.

endmenu
```

## firmware/rx-node/sdkconfig.defaults
```kconfig
# Partition table
CONFIG_PARTITION_TABLE_CUSTOM=y
CONFIG_PARTITION_TABLE_CUSTOM_FILENAME="partitions.csv"

# PSRAM (N16R8: 8 MB Octal)
CONFIG_SPIRAM=y
CONFIG_SPIRAM_MODE_OCT=y
CONFIG_SPIRAM_SPEED_80M=y

# WiFi
CONFIG_ESP_WIFI_STATIC_RX_BUFFER_NUM=16
CONFIG_ESP_WIFI_DYNAMIC_RX_BUFFER_NUM=32
CONFIG_ESP_WIFI_TX_BUFFER_TYPE=0
CONFIG_ESP_WIFI_STATIC_TX_BUFFER_NUM=16
CONFIG_ESP_WIFI_CSI_ENABLED=y

# Promiscuous mode
CONFIG_ESP_WIFI_PROMISCUOUS_MODE=y

# FreeRTOS
CONFIG_FREERTOS_HZ=1000
CONFIG_FREERTOS_TIMER_TASK_STACK_DEPTH=3072

# Log level
CONFIG_LOG_DEFAULT_LEVEL_INFO=y
CONFIG_LOG_MAXIMUM_LEVEL_DEBUG=y

# SNTP
CONFIG_LWIP_SNTP_MAX_SERVERS=1

# Task watchdog
CONFIG_ESP_TASK_WDT_TIMEOUT_S=10

# LWIP — larger UDP receive buffer for CSI streaming
CONFIG_LWIP_SO_RCVBUF=y
```

## firmware/tx-node/components/csi_tx/Kconfig
```kconfig
menu "CSI TX Configuration"

    config CSI_TX_RATE_HZ
        int "TX frame injection rate (Hz)"
        range 10 500
        default 100
        help
            Rate at which ESP-NOW broadcast frames are sent.
            100 Hz is standard for motion detection.
            200 Hz for gesture recognition.

endmenu
```

## firmware/tx-node/components/health_check/Kconfig
```kconfig
menu "Health Check Configuration"

    config CSI_HEALTH_INTERVAL_MS
        int "Health check log interval (ms)"
        range 1000 60000
        default 10000
        help
            Interval in milliseconds between health status log messages.
            Also controls watchdog feed rate.

    config CSI_HEALTH_TASK_STACK
        int "Health check task stack size (bytes)"
        range 1024 8192
        default 2048
        help
            Stack size for the health check task.

endmenu
```

## firmware/tx-node/components/time_sync/Kconfig
```kconfig
menu "Time Sync Configuration"

    config CSI_SNTP_SERVER
        string "SNTP server address"
        default "192.168.4.1"
        help
            IP address or hostname of the SNTP server (usually the Pi AP).

    config CSI_SNTP_SYNC_TIMEOUT
        int "SNTP sync timeout retries"
        range 1 30
        default 7
        help
            Number of 2-second retries waiting for initial SNTP sync.

endmenu
```

## firmware/tx-node/components/wifi_manager/Kconfig
```kconfig
menu "WiFi Manager Configuration"

    config CSI_WIFI_SSID
        string "WiFi hotspot SSID"
        default "iPhone"
        help
            SSID of the WiFi hotspot (e.g. iPhone personal hotspot).

    config CSI_WIFI_PASSWORD
        string "WiFi hotspot password"
        default "changeme123"
        help
            WPA2 password for the WiFi hotspot.

    config CSI_WIFI_CHANNEL
        int "WiFi channel (0 = auto-scan)"
        range 0 13
        default 0
        help
            WiFi channel. Set to 0 for auto-scan (recommended when using
            a phone hotspot since the channel is chosen by the phone).

    config CSI_WIFI_MAX_RETRY
        int "Maximum WiFi reconnect attempts"
        range 0 255
        default 10
        help
            Number of reconnect attempts before giving up. 0 = infinite.

endmenu
```

## firmware/tx-node/sdkconfig.defaults
```kconfig
# Partition table
CONFIG_PARTITION_TABLE_CUSTOM=y
CONFIG_PARTITION_TABLE_CUSTOM_FILENAME="partitions.csv"

# PSRAM (N16R8: 8 MB Octal)
CONFIG_SPIRAM=y
CONFIG_SPIRAM_MODE_OCT=y
CONFIG_SPIRAM_SPEED_80M=y

# WiFi
CONFIG_ESP_WIFI_STATIC_RX_BUFFER_NUM=16
CONFIG_ESP_WIFI_DYNAMIC_RX_BUFFER_NUM=32
CONFIG_ESP_WIFI_TX_BUFFER_TYPE=0
CONFIG_ESP_WIFI_STATIC_TX_BUFFER_NUM=16

# ESP-NOW
CONFIG_ESP_WIFI_ESPNOW_MAX_ENCRYPT_NUM=0

# FreeRTOS
CONFIG_FREERTOS_HZ=1000
CONFIG_FREERTOS_TIMER_TASK_STACK_DEPTH=3072

# Log level
CONFIG_LOG_DEFAULT_LEVEL_INFO=y
CONFIG_LOG_MAXIMUM_LEVEL_DEBUG=y

# SNTP
CONFIG_LWIP_SNTP_MAX_SERVERS=1

# Task watchdog
CONFIG_ESP_TASK_WDT_TIMEOUT_S=10
```

## firmware/tx-node/sdkconfig.defaults.esp32s3
```kconfig
# ESP32-S3 specific settings
CONFIG_IDF_TARGET="esp32s3"

# PSRAM Octal SPI (N16R8)
CONFIG_SPIRAM=y
CONFIG_SPIRAM_MODE_OCT=y
CONFIG_SPIRAM_SPEED_80M=y

# Flash (16 MB Quad SPI)
CONFIG_ESPTOOLPY_FLASHSIZE_16MB=y
CONFIG_ESPTOOLPY_FLASHMODE_QIO=y
```
